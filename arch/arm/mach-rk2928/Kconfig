## arch/arm/mach-rk2928/Kconfig
```kconfig
if ARCH_RK2928

choice
	prompt "RK2928 Board Type"
	default MACH_RK2928_SDK

config MACH_RK2928
	bool "RK2928 Board"
	select RK_CONFIG


config MACH_RK2928_SDK
	bool "RK2928(BGA) SDK board"

        config MACH_RK2928_TR726
                tristate "rk2928 TR726 "
                depends on MACH_RK2928_SDK

config MACH_RK2926_SDK
	bool "RK2926 SDK board"

        config MACH_RK2926_V86
		tristate "rk2926 v86 "
		depends on MACH_RK2926_SDK

	     config  MACH_BAINENGDA_VERSION
		    bool  "USE PMU DAC FOR WIFI POWER CONTROL"
		    depends on  MACH_RK2926_V86

config MACH_RK2928_PHONEPAD
	bool "RK2928_PhonePad board"

config MACH_RK2928_A720
	bool "RK2928 A720 board"

config MACH_RK2928_TB
	bool "RK2928 top board"

config MACH_RK2928_FPGA
	bool "RK2928 FPGA board"

endchoice

endif
```

## drivers/input/touchscreen/gslx680/Kconfig
```kconfig
#
# Touchscreen driver configuration
#

menu "gslX680 touchscreen panel support"
config TOUCHSCREEN_GSLX680
	tristate "gslX680 touchscreen panel support"
	depends on I2C2_RK29 || I2C2_RK30

comment "Touchscreen hardware drivers"
	depends on TOUCHSCREEN_GSLX680
	
choice
    depends on TOUCHSCREEN_GSLX680
	prompt  "Touch Screen Select"

	config TOUCHSCREEN_GSL1680_7INCH_800x480_LEHENG
  	bool "7 inch 800x480(Le Heng)"
	
	config TOUCHSCREEN_GSL1680_7INCH_800x480_SHENGHEXIANG
  	bool "7 inch 800x480(Sheng He Xiang)"
	
	config TOUCHSCREEN_GSL1680_7INCH_800x480_YOUCHU
  	bool "7 inch 800x480(You Chu)"
	
	config TOUCHSCREEN_GSL1680_7INCH_800x480_YOUCHU_YISENG
  	bool "7 inch 800x480(You Chu)(customer: Yi Seng)"
	
	config TOUCHSCREEN_GSL1680_7INCH_1024x600_YOUCHU
  	bool "7 inch 1024x600(You Chu)"

	config TOUCHSCREEN_GSL1680_7INCH_1024x600_SHENGHEXIANG
  	bool "7 inch 1024x600(Sheng He Xiang)"

	config GSLX680_9INCH_800X480
  	bool "9 inch 800x480"
	
	config GSLX680_9INCH_800X480_TENGYAO
  	bool "9 inch 800x480 (TengYao)"
	
	config GSLX680_9INCH_1024X600
  	bool "9 inch 1024x600"
	
	config GSLX680_8INCH_800X600
  	bool "8 inch 800x600"

	config GSLX680_8INCH_1024X600
  	bool "8 inch 1024x600"

	config GSLX680_8INCH_1024X768
  	bool "8 inch 1024x768"	
endchoice	

endmenu
```
